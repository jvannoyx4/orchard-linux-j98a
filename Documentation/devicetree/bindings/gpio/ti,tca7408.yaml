## Documentation/devicetree/bindings/gpio/ti,tca7408.yaml
```yaml
# SPDX-License-Identifier: (GPL-2.0-only OR BSD-2-Clause)
%YAML 1.2
---
$id: http://devicetree.org/schemas/gpio/ti,tca7408.yaml#
$schema: http://devicetree.org/meta-schemas/core.yaml#

title: Texas Instruments TCA7408 I2C GPIO expander

maintainers:
  - Linux GPIO mailing list <linux-gpio@vger.kernel.org>

properties:
  compatible:
    const: ti,tca7408

  reg:
    enum: [0x43, 0x44]

  gpio-controller: true

  "#gpio-cells":
    const: 2

  gpio-line-names:
    minItems: 1
    maxItems: 8

required:
  - compatible
  - reg
  - gpio-controller
  - "#gpio-cells"

additionalProperties: false

examples:
  - |
    i2c {
        #address-cells = <1>;
        #size-cells = <0>;

        gpio@43 {
            compatible = "ti,tca7408";
            reg = <0x43>;
            gpio-controller;
            #gpio-cells = <2>;
        };
    };
```

## Documentation/devicetree/bindings/spi/apple,spi-peripheral-props.yaml
```yaml
# SPDX-License-Identifier: (GPL-2.0-only OR BSD-2-Clause)
%YAML 1.2
---
$id: http://devicetree.org/schemas/spi/apple,spi-peripheral-props.yaml#
$schema: http://devicetree.org/meta-schemas/core.yaml#

title: Peripheral-specific properties for Apple SPI controllers

maintainers:
  - Paul Praschl <praschlpaul@g-p.at>

select: false

properties:
  apple,half-clock-delay:
    type: boolean
    description:
      Enable the SPI controller's half-clock-delay timing for this peripheral.
      On S8001 this sets configuration bit 20 and requires an inter-word delay
      of at least two controller input clocks. Longer requested word delays
      are preserved. This flag is independent of clock polarity and phase.
      Supported on S8001 with 8-bit transfers.

additionalProperties: true
...
```
